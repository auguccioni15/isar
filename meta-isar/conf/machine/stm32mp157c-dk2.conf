## meta-isar/conf/machine/stm32mp157c-dk2.conf
```bitbake
#
# Copyright (c) Siemens AG, 2020-2025
#
# SPDX-License-Identifier: MIT

require conf/machine/stm32mp15x.conf

MACHINEOVERRIDES =. "stm32mp15x:"

KERNEL_NAME = "stm32mp"

COMPATIBLE_MACHINE:stm32mp157c-dk2 = "^(stm32mp15x|stm32mp157c-dk2)$"

# WIC: ST standard layout con bootfs separato
WKS_FILE:stm32mp157c-dk2 = "stm32mp15x-dk2.wks.in"

# Kernel + DK2 DTB copiati nella partizione FAT32 bootfs
DTB_FILES = "stm32mp157c-dk2.dtb"
IMAGE_BOOT_FILES:stm32mp157c-dk2 = "vmlinuz stm32mp157c-dk2.dtb"

U_BOOT_CONFIG:stm32mp157c-dk2 = "stm32mp15_trusted_defconfig && \
    sed -i 's/CONFIG_DEFAULT_DEVICE_TREE=.*/CONFIG_DEFAULT_DEVICE_TREE=\"stm32mp157c-dk2\"/' .config"
U_BOOT_BIN:stm32mp157c-dk2 = "u-boot.stm32"

# TF-A: stm32mp157c-dk2.dtb include STPMIC1 (stpmic@33) via stm32mp15xx-dkx.dtsi
TF_A_EXTRA_BUILDARGS:stm32mp157c-dk2 = " \
    ARCH=aarch32 ARM_ARCH_MAJOR=7 AARCH32_SP=optee \
    STM32MP_SDMMC=1 STM32MP_EMMC=1 \
    STM32MP_RAW_NAND=1 STM32MP_SPI_NAND=1 STM32MP_SPI_NOR=1 \
    DTB_FILE_NAME=stm32mp157c-dk2.dtb"
TF_A_BINARIES:stm32mp157c-dk2 = "release/tf-a-stm32mp157c-dk2.stm32"

IMAGE_PREINSTALL += "weston wvkbd adwaita-icon-theme network-manager iw wpasupplicant iproute2 nano wireless-regdb firmware-brcm80211 bluez"

# fTPM initramfs hook requires CFG_EARLY_TA in OP-TEE to work; without it
# /dev/tpmrm0 is not available at initramfs time and the hook blocks rootfs mount.
IMAGE_INSTALL:remove = "initramfs-tee-ftpm-hook"

# Weston systemd service + U-Boot kernel cmdline config (dpkg-raw packages)
IMAGE_INSTALL:append:stm32mp157c-dk2 = " u-boot-script weston-dk2-config u-boot-script-stm32mp157c-dk2 firmware-brcm-dk2"

# root login: unlock account with empty password (development only)
USERS += "root"
USER_root[password] = ""
USER_root[flags] = "allow-empty-password"
```

## meta-isar/conf/machine/stm32mp157f-dk2.conf
```bitbake
#
# Copyright (c) Siemens AG, 2020-2025
#
# SPDX-License-Identifier: MIT
#
# STM32MP157F-DK2: variante F (aggiunge CryptoCell-312) della DK2.
# TF-A 2.4 non ha un DTS specifico per la variante F, quindi usa
# lo stesso stm32mp157c-dk2.dtb (STPMIC1 incluso via stm32mp15xx-dkx.dtsi).

require conf/machine/stm32mp15x.conf

MACHINEOVERRIDES =. "stm32mp15x:"

COMPATIBLE_MACHINE:stm32mp157f-dk2 = "^(stm32mp15x|stm32mp157f-dk2)$"

# WIC: ST standard layout con bootfs separato
WKS_FILE:stm32mp157f-dk2 = "stm32mp15x-dk2.wks.in"

# Kernel + DK2 DTB copiati nella partizione FAT32 bootfs
DTB_FILES = "stm32mp157c-dk2.dtb"
IMAGE_BOOT_FILES:stm32mp157f-dk2 = "vmlinuz stm32mp157c-dk2.dtb"

U_BOOT_CONFIG:stm32mp157f-dk2 = "stm32mp15_trusted_defconfig && \
    sed -i 's/CONFIG_DEFAULT_DEVICE_TREE=.*/CONFIG_DEFAULT_DEVICE_TREE=\"stm32mp157c-dk2\"/' .config"
U_BOOT_BIN:stm32mp157f-dk2 = "u-boot.stm32"

# TF-A 2.4 non ha DTS per la variante F; usa stm32mp157c-dk2.dtb (stesso PMIC)
TF_A_EXTRA_BUILDARGS:stm32mp157f-dk2 = " \
    ARCH=aarch32 ARM_ARCH_MAJOR=7 AARCH32_SP=optee \
    STM32MP_SDMMC=1 STM32MP_EMMC=1 \
    STM32MP_RAW_NAND=1 STM32MP_SPI_NAND=1 STM32MP_SPI_NOR=1 \
    DTB_FILE_NAME=stm32mp157c-dk2.dtb"
TF_A_BINARIES:stm32mp157f-dk2 = "release/tf-a-stm32mp157c-dk2.stm32"

IMAGE_PREINSTALL += "weston"

# WiFi firmware (brcmfmac/cyfmac43430) + BT firmware dal repo linux-firmware (ricetta custom)
IMAGE_INSTALL:append:stm32mp157f-dk2 = " linux-firmware"
# bluez: stack userspace BT da Debian (bluetoothd, bluetoothctl)
IMAGE_PREINSTALL:append:stm32mp157f-dk2 = " bluez"
```
